#define SPEAKER 3
#define DRUMS 5
#define INTERVAL 160
#define NOTE_SPACING 16
const uint16_t FREQUENCIES[]={0,31,33,35,37,39,41,44,46,49,52,55,58,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4699,4978};
const uint16_t SONG_LENGTH=64;
const uint8_t LEADTK[]={52,0,0,0,51,0,0,0,49,0,44,0,44,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0,0};
const uint8_t LEADLN[]={4,0,0,0,4,0,0,0,2,0,1,0,1,1,1,1,1,1,1,1,2,0,1,1,0,0,1,0,1,1,1,1,1,1,1,1,2,0,1,1,0,0,1,0,1,1,1,1,1,1,1,1,2,0,1,2,0,3,0,0,0,0,0};
const uint8_t DRUMTK[]={0,0,0,0,0,0,0,0,30,0,0,5,5,0,5,0,30,0,0,5,5,0,5,0,30,0,0,5,5,0,5,0,30,0,0,5,5,0,5,0,30,0,0,5,5,0,5,0,30,0,0,5,5,0,5,0,30,0,0,5,5,0,5,0};
void setup() {
  pinMode(2, OUTPUT);   
      digitalWrite(2, HIGH);
  pinMode(SPEAKER,OUTPUT);
  pinMode(DRUMS,OUTPUT);
}
uint16_t ctr=0,t=0;
void loop() {
  t=millis();
  if(LEADLN[ctr]!=0){
    noTone(SPEAKER);
    if(LEADTK[ctr]!=0) tone(SPEAKER,FREQUENCIES[LEADTK[ctr]],LEADLN[ctr]*INTERVAL-NOTE_SPACING);
  }
  if(DRUMTK[ctr]!=0){
    digitalWrite(DRUMS,HIGH);
    delay(DRUMTK[ctr]);
    digitalWrite(DRUMS,LOW);
  }
  ctr=(ctr+1)%SONG_LENGTH;
  delay(INTERVAL-(millis()-t));
}
